## meta-linux4space/conf/layer.conf
```bitbake
# We have a conf and classes directory, add to BBPATH
BBPATH .= ":${LAYERDIR}"

# We have recipes-* directories, add to BBFILES
BBFILES += "${LAYERDIR}/recipes-*/*/*.bb \
            ${LAYERDIR}/recipes-*/*/*.bbappend"

BBFILE_COLLECTIONS += "meta-linux4space"
BBFILE_PATTERN_meta-linux4space = "^${LAYERDIR}/"
BBFILE_PRIORITY_meta-linux4space = "6"

LAYERDEPENDS_meta-linux4space = "core"
LAYERSERIES_COMPAT_meta-linux4space = "nanbield"
```
